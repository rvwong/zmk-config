## config/west.yml
```yaml
manifest:
  remotes:
    - name: zmkfirmware
      url-base: https://github.com/zmkfirmware
    - name: microsoft
      url-base: https://github.com/microsoft
    - name: infused-kim
      url-base: https://github.com/infused-kim
    # Additional modules containing boards/shields/custom code can be listed here as well
    # See https://docs.zephyrproject.org/3.2.0/develop/west/manifest.html#projects

  projects:
    - name: zmk
      remote:  zmkfirmware
      revision: pull/2154/head
      clone-depth: 1
      import: 
  self:
    path: config
```
